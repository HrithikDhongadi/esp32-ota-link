## firmware/main/Kconfig.projbuild
```kconfig
menu "esp32_ota_link example"

config ESP32_OTA_LINK_EXAMPLE_FORCE_INVALID
    bool "Force example app OTA validation failure"
    default n
    help
        Enable this only for rollback testing. The example app will wait a few
        seconds, mark itself invalid, and reboot into the previous valid OTA
        partition.

config ESP32_OTA_LINK_EXAMPLE_REQUIRE_AUTH
    bool "Require OTA link authentication in the example app"
    default n
    help
        Require HMAC-SHA256 authentication for reboot, rollback, OTA update,
        and abort commands. PING and GET_INFO remain available.

config ESP32_OTA_LINK_EXAMPLE_AUTH_KEY
    string "OTA link example authentication key"
    default "service-secret"
    depends on ESP32_OTA_LINK_EXAMPLE_REQUIRE_AUTH
    help
        Demo pre-shared key used by the example app when authentication is
        enabled. Replace this in real products and avoid committing secrets.

endmenu
```

## firmware/sdkconfig.defaults
```kconfig
CONFIG_PARTITION_TABLE_CUSTOM=y
CONFIG_PARTITION_TABLE_CUSTOM_FILENAME="partitions.csv"
CONFIG_PARTITION_TABLE_FILENAME="partitions.csv"
CONFIG_APP_PROJECT_VER_FROM_CONFIG=y
CONFIG_APP_PROJECT_VER="0.1.3"
CONFIG_ESPTOOLPY_FLASHSIZE_4MB=y
CONFIG_ESPTOOLPY_FLASHSIZE="4MB"
CONFIG_ESP_MAIN_TASK_STACK_SIZE=8192
CONFIG_BOOTLOADER_APP_ROLLBACK_ENABLE=y
```
